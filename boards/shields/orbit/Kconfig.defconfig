## boards/shields/orbit/Kconfig.defconfig
```kconfig
if SHIELD_ORBIT_DONGLE

config ZMK_KEYBOARD_NAME
    default "Rog Orbit Pro"

config ZMK_SPLIT_ROLE_CENTRAL
    default y

endif

if SHIELD_ORBIT_DONGLE || SHIELD_ORBIT_LEFT || SHIELD_ORBIT_RIGHT

config ZMK_SPLIT
    default y

endif
```

## boards/shields/orbit/Kconfig.shield
```kconfig
config SHIELD_ORBIT_LEFT
    def_bool $(shields_list_contains,orbit_left)

config SHIELD_ORBIT_RIGHT
    def_bool $(shields_list_contains,orbit_right)

config SHIELD_ORBIT_DONGLE
    def_bool $(shields_list_contains,orbit_dongle)
```
